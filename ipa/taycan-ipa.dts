// SPDX-License-Identifier: BSD-3-Clause
/*
 * Copyright (c) Qualcomm Technologies, Inc. and/or its subsidiaries.
 */

/dts-v1/;
/plugin/;

#include <dt-bindings/interrupt-controller/arm-gic.h>
#include <dt-bindings/soc/qcom,ipcc.h>
#include <dt-bindings/interconnect/qcom,ravelin.h>
#include <dt-bindings/clock/qcom,rpmh.h>
#include "taycan-ipa.dtsi"

/ {
	model = "Qualcomm Technologies, Inc. Taycan";
	compatible = "qcom,ravelin";
	qcom,msm-id = <568 0x10000>, <581 0x10000>, <734 0x10000>;
	qcom,board-id = <34 0>, <34 0x601>, <0x10022 3>, <0x1000B 0>, <0x10022 0x603>;
};
