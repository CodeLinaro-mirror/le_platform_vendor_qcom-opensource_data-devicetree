// SPDX-License-Identifier: BSD-3-Clause
/*
 * Copyright (c) Qualcomm Technologies, Inc. and/or its subsidiaries. 
 */

/dts-v1/;
/plugin/;

#include "sdxecho-ipa.dtsi"

/ {
	model = "Qualcomm Technologies, Inc. SDXECHO";
	compatible = "qcom,sdxecho";

	qcom,msm-id = <701 0x10000>;
	qcom,board-id = <0 0>, <0x10021 0x0>, <0x10022 0x0>, <0x3010022 0x403>,
		<0x3020022 0x403>, <0x3030022 0x303>, <0x3040022 0x303>,
		<0x1010022 0x401>, <0x2010022 0x0>, <0x2020022 0x0>,
		<0x2030022 0x0>, <0x4010022 0x0>, <0x10015 0x0>,
		<0x20015 0x0>;
};
