// SPDX-License-Identifier: BSD-3-Clause
/*
 * Copyright (c) Qualcomm Technologies, Inc. and/or its subsidiaries.
 */

/dts-v1/;
/plugin/;

#include "echo-ipa.dtsi"

/ {
	model = "Qualcomm Technologies, Inc. echo";
	compatible = "qcom,echo", "qcom,echo-idp", "qcom,idp", "qcom,echo-iot";

	qcom,msm-id = <701 0x10000>, <772 0x10000>, <787 0x10000>;
	qcom,board-id = <0 0>, <0x10021 0x0>, <0x10022 0x0>, <0x3010022 0x403>,
		<0x3020022 0x403>, <0x3030022 0x303>, <0x3040022 0x303>,
		<0x1010022 0x401>, <0x2010022 0x0>, <0x2020022 0x0>,
		<0x2030022 0x0>, <0x4010022 0x0>, <0x10015 0x0>,
		<0x20015 0x0>, <0x1020022 0x401>, <0x2050022 0x0>,
		<0x2060022 0x0>, <0x5010022 0x0>, <0x5020022 0x0>,
		<0x5010022 0x605>, <0x5020022 0x605>, <0x5030022 0x605>,
		<0x5040022 0x605>;
};
