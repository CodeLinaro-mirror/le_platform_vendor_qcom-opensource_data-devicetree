// SPDX-License-Identifier: BSD-3-Clause
/*
 * Copyright (c) 2025 Qualcomm Innovation Center, Inc. All rights reserved.
 */

/dts-v1/;
/plugin/;

#include "sdxkova-idp-cpe-v2.dtsi"
#include "../eth/sdxkova-idp-cpe.dtsi"

/ {
        model = "Qualcomm Technologies, Inc. SDXKOVA IDP CPE V2";
        compatible = "qcom,sdxkova-idp",
                        "qcom,sdxkova", "qcom,idp";
        qcom,msm-id = <677 0x10000>, <678 0x10000>, <679 0x10000>;
        qcom,board-id = <0x1020022 0x401>, <0x3020022 0x403>;
};
