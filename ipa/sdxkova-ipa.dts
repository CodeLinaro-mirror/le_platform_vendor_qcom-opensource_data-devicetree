// SPDX-License-Identifier: BSD-3-Clause
/*
 * Copyright (c) Qualcomm Technologies, Inc. and/or its subsidiaries.
 */

/dts-v1/;
/plugin/;

#include "sdxkova-ipa.dtsi"

/ {
	model = "Qualcomm Technologies, Inc. SDXKOVA Soc";
	compatible = "qcom,sdxkova-idp", "qcom,sdxkova-rcm",
			"qcom,sdxkova", "qcom,idp", "qcom,rcm";

	qcom,msm-id = <677 0x10000>, <678 0x10000>, <679 0x10000>;
	qcom,board-id = <0x1050022 0x401>, <0x3010022 0x303>,
		<0x3020022 0x303>, <0x2010022 0x302>, <0x2020022 0x302>, <0x2030022 0x302>,
		<0x2060022 0x202>, <0x10015 0x300>, <0x20015 0x300>,
		<0x30015 0x300>, <0x10021 0x400>, <0x10001 0x300>, <0x10022 0x300>;
};
