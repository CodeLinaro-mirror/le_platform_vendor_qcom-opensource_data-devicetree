// SPDX-License-Identifier: BSD-3-Clause
/*
 * Copyright (c) 2025 Qualcomm Innovation Center, Inc. All rights reserved.
 */

/dts-v1/;
/plugin/;

#include "sdxkova-ipa.dtsi"

&ipa_hw {
	qcom,use-dual-wkk-config;
};
