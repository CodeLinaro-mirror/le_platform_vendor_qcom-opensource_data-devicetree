// SPDX-License-Identifier: BSD-3-Clause
/*
 * Copyright (c) 2025 Qualcomm Innovation Center, Inc. All rights reserved.
 */

#include "sdxkova-ipa.dtsi"

&ipa_eth_group2 {
	qcom,iommu-dma = "bypass";
};

&ipa_smmu_ap {
	qcom,iommu-dma = "atomic";
};
