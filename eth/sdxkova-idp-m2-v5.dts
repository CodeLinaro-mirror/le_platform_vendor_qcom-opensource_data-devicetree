// SPDX-License-Identifier: BSD-3-Clause
/*
 * Copyright (c) Qualcomm Technologies, Inc. and/or its subsidiaries.
 */

/dts-v1/;
/plugin/;

#include "sdxkova-idp-m2-v5.dtsi"
#include "../ipa/sdxkova-ipa.dtsi"

/ {
	model = "Qualcomm Technologies, Inc. SDXKOVA IDP M2 V5";
	compatible = "qcom,sdxkova-idp",
			"qcom,sdxkova", "qcom,idp";
	qcom,msm-id = <677 0x10000>, <678 0x10000>, <679 0x10000>;
	qcom,board-id = <0x2050022 0x302>;
};
