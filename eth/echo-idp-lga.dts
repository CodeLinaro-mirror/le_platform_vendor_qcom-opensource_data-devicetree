// SPDX-License-Identifier: BSD-3-Clause
/*
 * Copyright (c) Qualcomm Technologies, Inc. and/or its subsidiaries.
 */

/dts-v1/;
/plugin/;

#include "echo-eth.dtsi"

/ {
	model = "Qualcomm Technologies, Inc. echo IDP LGA";
	compatible = "qcom,echo-idp",
			"qcom,echo", "qcom,idp";
	qcom,msm-id = <701 0x10000>, <787 0x10000>;
	qcom,board-id = <0x5010022 0x0>, <0x5020022 0x0>, <0x5030022 0x605>, <0x5040022 0x605>,
			<0x5010022 0x605>, <0x5020022 0x605>;
};

&iemac1_tx_be {
	qcom,tcm-ring-size = <32 127>;
	qcom,tcm_buf_en;
	qcom,tcm_desc_en;
};
