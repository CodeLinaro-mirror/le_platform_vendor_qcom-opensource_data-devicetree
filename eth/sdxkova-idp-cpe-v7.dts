// SPDX-License-Identifier: BSD-3-Clause
/*
 * Copyright (c) Qualcomm Technologies, Inc. and/or its subsidiaries.
 */

/dts-v1/;
/plugin/;

#include "sdxkova-idp-cpe-v7.dtsi"
#include "../ipa/sdxkova-ipa.dtsi"

/ {
	model = "Qualcomm Technologies, Inc. SDXKOVA IDP CPE V7";
	compatible = "qcom,sdxkova-idp",
			"qcom,sdxkova", "qcom,idp";
	qcom,msm-id = <726 0x10000>, <725 0x10000>;
	qcom,board-id = <0x1070022 0x401>;
};
