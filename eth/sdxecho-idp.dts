// SPDX-License-Identifier: BSD-3-Clause
/*
 * Copyright (c) Qualcomm Technologies, Inc. and/or its subsidiaries.
 */

/dts-v1/;
/plugin/;

#include "sdxecho-eth-ioss.dtsi"

/ {
	model = "Qualcomm Technologies, Inc. SDXECHO IDP";
	compatible = "qcom,sdxecho-idp",
		"qcom,sdxecho", "qcom,idp";
	qcom,msm-id = <701 0x10000>;
	qcom,board-id = <0x10022 0x0>;

};
