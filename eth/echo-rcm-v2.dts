// SPDX-License-Identifier: BSD-3-Clause
/*
 * Copyright (c) Qualcomm Technologies, Inc. and/or its subsidiaries.
 */

/dts-v1/;
/plugin/;

#include "echo-eth.dtsi"

/ {
    model = "Qualcomm Technologies, Inc. ECHO RCM V2";
    compatible = "qcom,echo-rcm",
            "qcom,echo", "qcom,rcm";
    qcom,msm-id = <701 0x10000>, <787 0x10000>;
    qcom,board-id = <0x20015 0x0>;
};

&iemac0_tx_be {
	qcom,tcm-ring-size = <32 63>;
	qcom,tcm_buf_en;
	qcom,tcm_desc_en;
};

&iemac1_tx_be {
	qcom,tcm-ring-size = <32 63>;
	qcom,tcm_buf_en;
	qcom,tcm_desc_en;
};
