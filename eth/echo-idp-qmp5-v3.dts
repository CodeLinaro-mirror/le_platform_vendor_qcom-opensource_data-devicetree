// SPDX-License-Identifier: BSD-3-Clause
/*
 * Copyright (c) Qualcomm Technologies, Inc. and/or its subsidiaries.
 */

/dts-v1/;
/plugin/;

#include "echo-eth-ioss.dtsi"

/ {
	model = "Qualcomm Technologies, Inc. echo IDP QMP5 V3";
	compatible = "qcom,echo-idp",
			"qcom,echo", "qcom,idp";
	qcom,msm-id = <701 0x10000>;
	qcom,board-id = <0x2030022 0x0>;
};
