// SPDX-License-Identifier: BSD-3-Clause
/*
 * Copyright (c) 2024-2025 Qualcomm Innovation Center, Inc. All rights reserved.
 */

/dts-v1/;
/plugin/;
#include "sdxkova-idp-mbb.dtsi"
#include "../ipa/sdxkova-ipa.dtsi"

/ {
	model = "Qualcomm Technologies, Inc. SDXKOVA IDP MBB";
	compatible = "qcom,sdxkova-idp",
		"qcom,sdxkova", "qcom,idp", "qcom,sdxkova-rcm", "qcom,rcm";
	qcom,msm-id = <677 0x10000>, <678 0x10000>, <679 0x10000>;
	qcom,board-id = <0x30022 0x400>, <0x40022 0x400>, <0x30015 0x400>;
};
