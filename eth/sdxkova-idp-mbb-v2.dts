// SPDX-License-Identifier: BSD-3-Clause
/*
 * Copyright (c) 2025 Qualcomm Innovation Center, Inc. All rights reserved.
 */

/dts-v1/;
/plugin/;
#include "sdxkova-idp-mbb-v2.dtsi"

/ {
	model = "Qualcomm Technologies, Inc. SDXKOVA IDP MBB V2";
	compatible = "qcom,sdxkova-idp",
			"qcom,sdxkova", "qcom,idp";
	qcom,msm-id = <677 0x10000>, <678 0x10000>, <679 0x10000>;
	qcom,board-id = <0x20022 0x300>, <0x20022 0x400>;
};
