// SPDX-License-Identifier: BSD-3-Clause
/*
 * Copyright (c) 2024 Qualcomm Innovation Center, Inc. All rights reserved.
 */

/dts-v1/;
/plugin/;
#include "sdxpinn-idp-mbb-v2.dtsi"

/ {
	model = "Qualcomm Technologies, Inc. SDXKOVA IDP MBB V2";
	compatible = "qcom,sdxkova-idp",
			"qcom,sdxkova", "qcom,idp";
	qcom,msm-id = <556 0x10000>, <580 0x10000>, <609 0x10000>, <610 0x10000>;
	qcom,board-id = <0x2020022 0x302>;
};
