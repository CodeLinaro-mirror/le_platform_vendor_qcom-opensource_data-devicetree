// SPDX-License-Identifier: BSD-3-Clause
/*
 * Copyright (c) Qualcomm Technologies, Inc. and/or its subsidiaries.
 */

/dts-v1/;
/plugin/;

#include "echo-eth.dtsi"

/ {
	model = "Qualcomm Technologies, Inc. echo IDP QMP5 sph=on";
	compatible = "qcom,echo-idp",
			"qcom,echo", "qcom,idp";
	qcom,msm-id = <701 0x10000>, <787 0x10000>;
	qcom,board-id = <0x2010022 0x0>,<0x2020022 0x0>,<0x2030022 0x0>;
};

/* Enable Split Header (SPH) on all EMAC instances */
&emac0 {
	snps,sph;
};

&emac1 {
	snps,sph;
};

&emac2 {
	snps,sph;
};
