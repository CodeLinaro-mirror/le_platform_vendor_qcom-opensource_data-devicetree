// SPDX-License-Identifier: BSD-3-Clause
/*
 * Copyright (c) Qualcomm Technologies, Inc. and/or its subsidiaries.
 */

/dts-v1/;
/plugin/;

#include "echo-eth.dtsi"

/ {
	model = "Qualcomm Technologies, Inc. SA535M TDP RGMII emac0 speed=100";
	compatible = "qcom,echo";
	qcom,msm-id = <703 0x10000>;
	qcom,board-id = <0x10030 0x0>, <0x10030 0x20000>;
};

/* Configure emac0 for RGMII mode at 100 Mbps (MAC-to-PHY) with Micrel PHY */
&emac0 {
	pinctrl-0 = <&emac0_pin_rgmii_txc
			&emac0_pin_rgmii_txd0
			&emac0_pin_rgmii_txd1
			&emac0_pin_rgmii_txd2
			&emac0_pin_rgmii_txd3
			&emac0_pin_rgmii_tx_ctl
			&emac0_pin_rgmii_rxc
			&emac0_pin_rgmii_rxd0
			&emac0_pin_rgmii_rxd1
			&emac0_pin_rgmii_rxd2
			&emac0_pin_rgmii_rxd3
			&emac0_pin_rgmii_rx_ctl
			&emac0_mdc_active
			&emac0_mdio_active>;
	pinctrl-1 = <&emac0_pin_rgmii_txc
			&emac0_pin_rgmii_txd0
			&emac0_pin_rgmii_txd1
			&emac0_pin_rgmii_txd2
			&emac0_pin_rgmii_txd3
			&emac0_pin_rgmii_tx_ctl
			&emac0_pin_rgmii_rxc
			&emac0_pin_rgmii_rxd0
			&emac0_pin_rgmii_rxd1
			&emac0_pin_rgmii_rxd2
			&emac0_pin_rgmii_rxd3
			&emac0_pin_rgmii_rx_ctl
			&emac0_mdc_inactive
			&emac0_mdio_inactive>;

	phy-mode = "rgmii-rxid";
	snps,reset-gpio = <&tlmm 75 1>;
	snps,reset-delays-us = <1000 10000 1000>;
	reset-names = "rgmii_clk_ares";
};

&emac0_phy {
	compatible = "ethernet-phy-ieee802.3-c22";
	reg = <0x7>;
};
